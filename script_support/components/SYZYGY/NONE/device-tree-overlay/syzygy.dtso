// SPDX-License-Identifier: (GPL-2.0 OR MIT)
/* Copyright (c) 2020-2021 Microchip Technology Inc */

/dts-v1/;
/plugin/;

&{/chosen} {
	overlays {
		NO-SYZYGY-GATEWARE = "Mon Oct  2 18:00:17 2023";
	};
};
